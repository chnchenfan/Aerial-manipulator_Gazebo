## src/modules/arm_joint_bridge/Kconfig
```kconfig
menuconfig MODULES_ARM_JOINT_BRIDGE
	bool "arm_joint_bridge"
	default n
	depends on MODULES_MAVLINK
	---help---
		Enable support for arm_joint_bridge

menuconfig USER_ARM_JOINT_BRIDGE
	bool "arm_joint_bridge running as userspace module"
	default n
	depends on BOARD_PROTECTED && MODULES_ARM_JOINT_BRIDGE
	---help---
		Put arm_joint_bridge in userspace memory
```

## src/modules/eso_att_control/Kconfig
```kconfig
menuconfig MODULES_ESO_ATT_CONTROL
	bool "eso_att_control"
	default n
	---help---
		Enable support for eso_att_control

menuconfig USER_ESO_ATT_CONTROL
	bool "eso_att_control running as userspace module"
	default n
	depends on BOARD_PROTECTED && MODULES_ESO_ATT_CONTROL
	---help---
		Put eso_att_control in userspace memory
```

## src/modules/eso_pos_control/Kconfig
```kconfig
menuconfig MODULES_ESO_POS_CONTROL
	bool "eso_pos_control"
	default n
	---help---
		Enable support for eso_pos_control

menuconfig USER_ESO_POS_CONTROL
	bool "eso_pos_control running as userspace module"
	default y
	depends on BOARD_PROTECTED && MODULES_ESO_POS_CONTROL
	---help---
		Put eso_pos_control in userspace memory
```

## src/modules/eso_rate_control/Kconfig
```kconfig
menuconfig MODULES_ESO_RATE_CONTROL
	bool "eso_rate_control"
	default n
	---help---
		Enable support for eso_rate_control

menuconfig USER_ESO_RATE_CONTROL
	bool "eso_rate_control running as userspace module"
	default n
	depends on BOARD_PROTECTED && MODULES_ESO_RATE_CONTROL
	---help---
		Put eso_rate_control in userspace memory
```
